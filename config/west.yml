## config/west.yml
```yaml
# This file specifies the build dependencies for Github Action workflows and
# for local build environments. The workspace has three toplevel directories
# containing the user config, user modules and ZMK. Zephyr and its dependencies
# are namespaced under /zmk to keep the toplevel clean.
#
# ZMK-Workspace
# ├── config
# ├── modules (user modules)
# └── zmk
#     └── modules (Zephyr modules)
#
# To create a local build environment, clone this repository and then run the
# following commands from its toplevel directory:
#
# $ west init -l config
# $ west update
# $ west zephyr-export
#
---
manifest:
  remotes:
    - name: zmkfirmware
      url-base: https://github.com/zmkfirmware
    - name: urob
      url-base: https://github.com/urob
    - name: rgbj
      url-base: https://github.com/rgbj
    - name: boardsource
      url-base: https://github.com/boardsource
    - name: local
      url-base: /Users/rgbj/g/github.com/rgbj

  projects:
    # - name: zmk-helpers
    #   remote: urob
    #   revision: main
    #   path: modules/helpers
    - name: zmk-auto-layer
      remote: urob
      revision: main
      path: modules/auto-layer
    - name: zmk-tri-state
      remote: urob
      revision: main
      path: modules/tri-state
    - name: zmk-rollow
      remote: rgbj
      revision: main
      path: modules/rollow
    - name: Rechtek-zmk-config
      remote: boardsource
      revision: main
      path: modules/rechteck

    # ZMK with Zephyr namespaced under /zmk. This requires that ZMK imports
    # Zephyr with a path other than `zephyr` (as in `going-modular`).
    - name: zmk
      remote: rgbj
      revision: zmkfirmware_main_2025-03-28+urob_going-modular_bits
      path: .
      import:
        file: app/west.yml
        path-prefix: zmk

  self:
    path: config
```
